## ch32v307vct6/board.yml
```yaml
board:
  name: ch32v307vct6
  full_name: WCH CH32V307VCT6
  vendor: wch
  socs:
    - name: ch32v307
```

## stm32f103zet6/board.yml
```yaml
board:
  name: stm32f103zet6
  full_name: STM32F103ZET6
  vendor: others
  socs:
    - name: stm32f103xe
```

## stm32f429igt6/Kconfig.defconfig
```kconfig
# black_f407ve board configuration

# Copyright (c) 2020 Intel Corporation
# SPDX-License-Identifier: Apache-2.0

if BOARD_STM32F429IGT6

config INPUT
	default y if DISPLAY

config MEMC
	default y if DISPLAY

endif # BOARD_STM32F429I_DISC1
```

## stm32f429igt6/Kconfig.stm32f429igt6
```kconfig
# Copyright (c) 2020 Intel Corporation
# SPDX-License-Identifier: Apache-2.0

config BOARD_STM32F429IGT6
	select SOC_STM32F429XX
```

## stm32f429igt6/board.yml
```yaml
board:
  name: stm32f429igt6
  full_name: STM32F429IGT6 Board
  vendor: stm32f429igt6
  socs:
    - name: stm32f429xx
```

## stm32h750vbt6/stm32h750vb/board.yml
```yaml
board:
  name: stm32h750vb
  full_name: STM32H750VB
  vendor: stm32h750vb
  socs:
    - name: stm32h750xx
```
